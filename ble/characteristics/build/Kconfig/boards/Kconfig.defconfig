## ble/characteristics/build/Kconfig/boards/Kconfig.defconfig
```kconfig
# Load Zephyr board defconfig descriptions.
osource "/opt/nordic/ncs/v3.4.1/zephyr/boards/nordic/nrf5340dk/Kconfig.defconfig"
```

## ble/characteristics/build/ipc_radio/Kconfig/boards/Kconfig.tmp
```kconfig
# Load Zephyr board Kconfig descriptions.
osource "/opt/nordic/ncs/v3.4.1/zephyr/boards/nordic/nrf5340dk/Kconfig"
```
