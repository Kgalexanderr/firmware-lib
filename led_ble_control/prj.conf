## CMakeLists.txt
```
cmake_minimum_required(VERSION 3.20.0)

find_package(Zephyr REQUIRED HINTS $ENV{ZEPHYR_BASE})
project(NONE)

# NORDIC SDK APP START
target_sources(app PRIVATE
  src/main.c
  src/lbcs.c
)

# NORDIC SDK APP END
zephyr_library_include_directories(.)
```

## prj.conf
```kconfig
# Logger module
CONFIG_CONSOLE=y
CONFIG_LOG=y
CONFIG_PRINTK=y
```

## src/main.c
```c
int main(void)
{
  printk("Hello, world!")
}
```
